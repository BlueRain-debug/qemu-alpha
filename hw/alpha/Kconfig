## hw/alpha/Kconfig
```kconfig
config CLIPPER
    bool
    default y
    depends on ALPHA
    imply PCI_DEVICES
    imply TEST_DEVICES
    select M1543
    select TSUNAMI
    select AM29F016
    select DEC_PCI

config TSUNAMI
    bool
    default y
    depends on ALPHA
    select PCI
    select TIGBUS
    select BITBANG_I2C

config AM29F016
    bool
    select PFLASH_CFI02
    select TIGBUS

config TIGBUS
    bool

config JENSEN
    bool
    default y
    depends on ALPHA
    select ISA_BUS
    select I8259
    select I8254
    select MC146818RTC
    select SERIAL_MM
    select PCKBD
    select VGA_ISA
    select JENSEN_S3
    select PFLASH_CFI01
    select I8257
    select FDC_ISA
    select SCSI

config ALPHASERVER_2100A
    bool
    default y
    depends on ALPHA
    select ISA_BUS
    select I8259
    select I8254
    select MC146818RTC
    select SERIAL_ISA
    select PCKBD
    select I2C
    select AT24C
    select PCI
    select VGA_CIRRUS
    select JENSEN_S3

config JENSEN_S3
    bool
    select VGA_ISA
```
